/*
 * Copyright (c) 2020 The ZMK Contributors
 * Copyright (c) 2025 Innaworks Development Limited, trading as MoErgo
 *
 * SPDX-License-Identifier: MIT
 */

#include <behaviors.dtsi>
/* Include all behavior includes needed */
#include <dt-bindings/zmk/outputs.h>
#include <dt-bindings/zmk/keys.h>
#include <dt-bindings/zmk/bt.h>
#include <dt-bindings/zmk/rgb.h>

// #include <dt-bindings/zmk/input_transform.h>
#include <dt-bindings/zmk/pointing.h>
#include <input/processors.dtsi>
#include <zephyr/dt-bindings/input/input-event-codes.h>

#include <zmk-helpers/helper.h>

#include "keys.h"
#include "os.h"

/* Layers */
#define LAYER_Base 0
#define LAYER_ColemakDH 0
#define LAYER_Typing 1
#define LAYER_LeftPinky 2
#define LAYER_LeftRingy 3
#define LAYER_LeftMiddy 4
#define LAYER_LeftIndex 5
#define LAYER_RightPinky 6
#define LAYER_RightRingy 7
#define LAYER_RightMiddy 8
#define LAYER_RightIndex 9
#define LAYER_Cursor 10
#define LAYER_Number 11
#define LAYER_Function 12
#define LAYER_Symbol 13
#define LAYER_Mouse 14
#define LAYER_MouseFine 15
#define LAYER_MouseSlow 16
#define LAYER_MouseFast 17
#define LAYER_MouseWarp 18
#define LAYER_Factory 19
#define LAYER_Lower 20
#define LAYER_Magic 21
#define ALL_LAYERS 0 1 2 3 4 5 6 7 8 9 10 11 12 13 14 15 16 17 18 19 20

// Basis for HRM and thumb hold-tap timing
#define TAPPING_RESOLUTION 175

#include "system.dtsi"
#include "macros.dtsi"
#include "combos.dtsi"
#include "mouse.dtsi"
#include "behaviors.dtsi"
#include "hrms.dtsi"
#include "layers.dtsi"

#define BASE   LAYER_ColemakDH
#define TYPING LAYER_Typing
#define CURSOR LAYER_Cursor
#define NUM    LAYER_Number
#define FUNC   LAYER_Function
#define SYM    LAYER_Symbol
#define MSE    LAYER_Mouse
#define FACT   LAYER_Factory
#define LWR    LAYER_Lower
#define MAG    LAYER_Magic

GLV80_LAYER(ColemakDH,
     &kp GRAVE         &kp Q         &kp W         &kp F               &kp P  &kp B,                                                                                                                      &kp J          &kp L           &kp U          &kp Y       &kp SEMI      &kp MINUS,
    &sft_capsw  &LeftPinky A  &LeftRingy R  &LeftMiddy S        &LeftIndex T  &kp G,                                                                                                                      &kp M  &RightIndex N   &RightMiddy E  &RightRingy I  &RightPinky O        &kp SQT,
         &none         &kp Z         &kp X         &kp C               &kp D  &kp V,          &thumb FUNC ESC       &parang_left         &parang_right,  &kp _HOME        &kp _END   &thumb MAG ENTER,  &kp K          &kp H       &kp COMMA        &kp DOT       &kp FSLH     &sft_capsw,
  &magic MAG 0     &kp EQUAL      &kp LBKT      &kp RBKT     &thumb MSE BSLH,         &thumb CURSOR BACKSPACE  &thumb NUM DELETE  &thumb TYPING INSERT, &tog TYPING  &thumb MSE TAB     &spc SYM SPACE,             &kp PG_DN     &msc MSC_DN    &msc MSC_UP       &kp PG_UP  &magic MAG 0 
)

GLV80_LAYER(Typing,
      &trans              &trans              &trans              &trans               &trans  &trans,                                                         &trans               &trans               &trans               &trans               &trans      &trans,
  &sft_capsw  &kp LEFT_PINKY_KEY  &kp LEFT_RINGY_KEY  &kp LEFT_MIDDY_KEY   &kp LEFT_INDEX_KEY  &trans,                                                         &trans  &kp RIGHT_INDEX_KEY  &kp RIGHT_MIDDY_KEY  &kp RIGHT_RINGY_KEY  &kp RIGHT_PINKY_KEY  &sft_capsw,
      &trans              &trans              &trans              &trans               &trans  &trans,  &trans  &trans  &trans,  &trans       &trans  &trans,  &trans               &trans               &trans               &trans               &trans      &trans,
      &trans  &kp LEFT_PINKY_MOD  &kp LEFT_RINGY_MOD  &kp LEFT_MIDDY_MOD  &kp LEFT_INDEX_MOD,           &trans  &trans  &trans,  &tog TYPING  &trans  &trans,          &kp RIGHT_INDEX_MOD  &kp RIGHT_MIDDY_MOD  &kp RIGHT_RINGY_MOD  &kp RIGHT_PINKY_MOD      &trans 
)

GLV80_LAYER_HRML(LeftPinky,
    &tap_LeftPinky KEY_LH_C6R3    &tap_LeftPinky KEY_LH_C5R3        &tap_LeftPinky KEY_LH_C4R3        &tap_LeftPinky KEY_LH_C3R3        &tap_LeftPinky KEY_LH_C2R3    &tap_LeftPinky KEY_LH_C1R3,
    &tap_LeftPinky KEY_LH_C6R4                         &none                   &LeftPinkyRingy                   &LeftPinkyMiddy                   &LeftPinkyIndex    &tap_LeftPinky KEY_LH_C1R4,
                        &trans    &tap_LeftPinky KEY_LH_C5R5        &tap_LeftPinky KEY_LH_C4R5        &tap_LeftPinky KEY_LH_C3R5        &tap_LeftPinky KEY_LH_C2R5    &tap_LeftPinky KEY_LH_C1R5,    &mo LAY_LH_T1    &tap_LeftPinky KEY_LH_T2    &tap_LeftPinky KEY_LH_T3,
                        &trans    &tap_LeftPinky KEY_LH_C5R6        &tap_LeftPinky KEY_LH_C4R6        &tap_LeftPinky KEY_LH_C3R6                  &mo LAY_LH_C2R6,                                   &mo LAY_LH_T4               &mo LAY_LH_T5    &mo LAY_LH_T6
)

GLV80_LAYER_HRML(LeftRingy,
    &tap_LeftRingy KEY_LH_C6R3        &tap_LeftRingy KEY_LH_C5R3    &tap_LeftRingy KEY_LH_C4R3        &tap_LeftRingy KEY_LH_C3R3        &tap_LeftRingy KEY_LH_C2R3    &tap_LeftRingy KEY_LH_C1R3,
    &tap_LeftRingy KEY_LH_C6R4                   &LeftRingyPinky                         &none                   &LeftRingyMiddy                   &LeftRingyIndex    &tap_LeftRingy KEY_LH_C1R4,
                        &trans        &tap_LeftRingy KEY_LH_C5R5    &tap_LeftRingy KEY_LH_C4R5        &tap_LeftRingy KEY_LH_C3R5        &tap_LeftRingy KEY_LH_C2R5    &tap_LeftRingy KEY_LH_C1R5,    &mo LAY_LH_T1    &tap_LeftRingy KEY_LH_T2    &tap_LeftRingy KEY_LH_T3,
                        &trans        &tap_LeftRingy KEY_LH_C5R6    &tap_LeftRingy KEY_LH_C4R6        &tap_LeftRingy KEY_LH_C3R6                  &mo LAY_LH_C2R6,                                   &mo LAY_LH_T4               &mo LAY_LH_T5    &mo LAY_LH_T6
)

GLV80_LAYER_HRML(LeftMiddy,
    &tap_LeftMiddy KEY_LH_C6R3        &tap_LeftMiddy KEY_LH_C5R3        &tap_LeftMiddy KEY_LH_C4R3    &tap_LeftMiddy KEY_LH_C3R3        &tap_LeftMiddy KEY_LH_C2R3    &tap_LeftMiddy KEY_LH_C1R3,
    &tap_LeftMiddy KEY_LH_C6R4                   &LeftMiddyPinky                   &LeftMiddyRingy                         &none                   &LeftMiddyIndex    &tap_LeftMiddy KEY_LH_C1R4,
                        &trans        &tap_LeftMiddy KEY_LH_C5R5        &tap_LeftMiddy KEY_LH_C4R5    &tap_LeftMiddy KEY_LH_C3R5        &tap_LeftMiddy KEY_LH_C2R5    &tap_LeftMiddy KEY_LH_C1R5,    &mo LAY_LH_T1    &tap_LeftMiddy KEY_LH_T2    &tap_LeftMiddy KEY_LH_T3,
                        &trans        &tap_LeftMiddy KEY_LH_C5R6        &tap_LeftMiddy KEY_LH_C4R6    &tap_LeftMiddy KEY_LH_C3R6                  &mo LAY_LH_C2R6,                                   &mo LAY_LH_T4               &mo LAY_LH_T5    &mo LAY_LH_T6
)

GLV80_LAYER_HRML(LeftIndex,
    &tap_LeftIndex KEY_LH_C6R3        &tap_LeftIndex KEY_LH_C5R3        &tap_LeftIndex KEY_LH_C4R3        &tap_LeftIndex KEY_LH_C3R3    &tap_LeftIndex KEY_LH_C2R3    &tap_LeftIndex KEY_LH_C1R3,
    &tap_LeftIndex KEY_LH_C6R4                   &LeftIndexPinky                   &LeftIndexRingy                   &LeftIndexMiddy                         &none    &tap_LeftIndex KEY_LH_C1R4,
                        &trans        &tap_LeftIndex KEY_LH_C5R5        &tap_LeftIndex KEY_LH_C4R5        &tap_LeftIndex KEY_LH_C3R5    &tap_LeftIndex KEY_LH_C2R5    &tap_LeftIndex KEY_LH_C1R5,    &mo LAY_LH_T1    &tap_LeftIndex KEY_LH_T2    &tap_LeftIndex KEY_LH_T3,
                        &trans        &tap_LeftIndex KEY_LH_C5R6        &tap_LeftIndex KEY_LH_C4R6        &tap_LeftIndex KEY_LH_C3R6              &mo LAY_LH_C2R6,                                   &mo LAY_LH_T4               &mo LAY_LH_T5    &mo LAY_LH_T6
)

GLV80_LAYER_HRMR(RightPinky,  
                                                                                &tap_RightPinky KEY_RH_C1R3         &tap_RightPinky KEY_RH_C2R3         &tap_RightPinky KEY_RH_C3R3         &tap_RightPinky KEY_RH_C4R3    &tap_RightPinky KEY_RH_C5R3    &tap_RightPinky KEY_RH_C6R3,
                                                                                &tap_RightPinky KEY_RH_C1R4                    &RightPinkyIndex                    &RightPinkyMiddy                    &RightPinkyRingy                          &none    &tap_RightPinky KEY_RH_C6R4,
    &tap_RightPinky KEY_RH_T3    &tap_RightPinky KEY_RH_T2    &mo LAY_RH_T1,    &tap_RightPinky KEY_RH_C1R5         &tap_RightPinky KEY_RH_C2R5         &tap_RightPinky KEY_RH_C3R5         &tap_RightPinky KEY_RH_C4R5    &tap_RightPinky KEY_RH_C5R5    &trans,
                &mo LAY_RH_T6                &mo LAY_RH_T5    &mo LAY_RH_T4,                                        &tap_RightPinky KEY_RH_C2R6         &tap_RightPinky KEY_RH_C3R6         &tap_RightPinky KEY_RH_C4R6    &tap_RightPinky KEY_RH_C5R6    &trans
)

GLV80_LAYER_HRMR(RightRingy,
                                                                                &tap_RightRingy KEY_RH_C1R3         &tap_RightRingy KEY_RH_C2R3         &tap_RightRingy KEY_RH_C3R3    &tap_RightRingy KEY_RH_C4R3         &tap_RightRingy KEY_RH_C5R3    &tap_RightRingy KEY_RH_C6R3,
                                                                                &tap_RightRingy KEY_RH_C1R4                    &RightRingyIndex                    &RightRingyMiddy                          &none                    &RightRingyPinky    &tap_RightRingy KEY_RH_C6R4,
    &tap_RightRingy KEY_RH_T3    &tap_RightRingy KEY_RH_T2    &mo LAY_RH_T1,    &tap_RightRingy KEY_RH_C1R5         &tap_RightRingy KEY_RH_C2R5         &tap_RightRingy KEY_RH_C3R5    &tap_RightRingy KEY_RH_C4R5         &tap_RightRingy KEY_RH_C5R5    &trans,
                &mo LAY_RH_T6                &mo LAY_RH_T5    &mo LAY_RH_T4,                                        &tap_RightRingy KEY_RH_C2R6         &tap_RightRingy KEY_RH_C3R6    &tap_RightRingy KEY_RH_C4R6         &tap_RightRingy KEY_RH_C5R6    &trans 
)

GLV80_LAYER_HRMR(RightMiddy,
                                                                                &tap_RightMiddy KEY_RH_C1R3         &tap_RightMiddy KEY_RH_C2R3    &tap_RightMiddy KEY_RH_C3R3         &tap_RightMiddy KEY_RH_C4R3         &tap_RightMiddy KEY_RH_C5R3    &tap_RightMiddy KEY_RH_C6R3,
                                                                                &tap_RightMiddy KEY_RH_C1R4                    &RightMiddyIndex                          &none                    &RightMiddyRingy                    &RightMiddyPinky    &tap_RightMiddy KEY_RH_C6R4,
    &tap_RightMiddy KEY_RH_T3    &tap_RightMiddy KEY_RH_T2    &mo LAY_RH_T1,    &tap_RightMiddy KEY_RH_C1R5         &tap_RightMiddy KEY_RH_C2R5    &tap_RightMiddy KEY_RH_C3R5         &tap_RightMiddy KEY_RH_C4R5         &tap_RightMiddy KEY_RH_C5R5    &trans,
                &mo LAY_RH_T6                &mo LAY_RH_T5    &mo LAY_RH_T4,                                        &tap_RightMiddy KEY_RH_C2R6    &tap_RightMiddy KEY_RH_C3R6         &tap_RightMiddy KEY_RH_C4R6         &tap_RightMiddy KEY_RH_C5R6    &trans 
)

GLV80_LAYER_HRMR(RightIndex,
                                                                                &tap_RightIndex KEY_RH_C1R3    &tap_RightIndex KEY_RH_C2R3         &tap_RightIndex KEY_RH_C3R3         &tap_RightIndex KEY_RH_C4R3         &tap_RightIndex KEY_RH_C5R3    &tap_RightIndex KEY_RH_C6R3,
                                                                                &tap_RightIndex KEY_RH_C1R4                          &none                    &RightIndexMiddy                    &RightIndexRingy                    &RightIndexPinky    &tap_RightIndex KEY_RH_C6R4,
    &tap_RightIndex KEY_RH_T3    &tap_RightIndex KEY_RH_T2    &mo LAY_RH_T1,    &tap_RightIndex KEY_RH_C1R5    &tap_RightIndex KEY_RH_C2R5         &tap_RightIndex KEY_RH_C3R5         &tap_RightIndex KEY_RH_C4R5         &tap_RightIndex KEY_RH_C5R5    &trans,
                &mo LAY_RH_T6                &mo LAY_RH_T5    &mo LAY_RH_T4,                                   &tap_RightIndex KEY_RH_C2R6         &tap_RightIndex KEY_RH_C3R6         &tap_RightIndex KEY_RH_C4R6         &tap_RightIndex KEY_RH_C5R6    &trans 
)

GLV80_LAYER(Cursor,
      &none             &kp RET           &kp SPACE             &kp TAB            &kp BSPC    &kp _CUT,                                                                           &kp _CUT  &kp LS(TAB)       &kp _UNDO       &kp _REDO    &kp TAB      &none,
  &sk LSHFT  &kp LEFT_PINKY_MOD  &kp LEFT_RINGY_MOD  &kp LEFT_MIDDY_MOD  &kp LEFT_INDEX_MOD   &kp _COPY,                                                                          &kp _COPY     &kp LEFT        &kp DOWN          &kp UP  &kp RIGHT  &sk LSHFT,
  &kp _C(L)         &select_all        &select_line        &select_word           &kp _FIND  &kp _PASTE,        &none  &none  &none,  &select_none  &extend_line  &extend_word,  &kp _PASTE    &kp _HOME       &kp PG_DN       &kp PG_UP   &kp _END  &kp _C(L),
  &kp _C(K)           &kp _UNDO           &kp _REDO      &kp _FIND_PREV     &kp _FIND_NEXT,               &tog CURSOR  &none  &none,   &select_all  &select_line  &select_word,                &kp _FIND  &kp _FIND_PREV  &kp _FIND_NEXT  &kp _C(H)  &kp _C(K)
)

GLV80_LAYER(Number,
          &kp E             &kp RET           &kp SPACE             &kp TAB            &kp BSPC  &kp N0,                                                                             &kp LS(G)      &kp N7      &kp N8      &kp N9   &kp LS(SEMI)     &kp LS(N5),
      &sk LSHFT  &kp LEFT_PINKY_MOD  &kp LEFT_RINGY_MOD  &kp LEFT_MIDDY_MOD  &kp LEFT_INDEX_MOD   &kp X,                                                                                 &kp K      &kp N4      &kp N5      &kp N6      &kp MINUS  &kp LS(EQUAL),
  &kp LS(MINUS)         &select_all        &select_line        &select_word           &kp _FIND   &kp F,  &none              &none   &none,  &kp LS(COMMA)  &kp LS(DOT)  &kp COMMA,      &kp J      &kp N1      &kp N2      &kp N3       &kp FSLH     &kp LS(N8),
          &none           &kp _UNDO           &kp _REDO      &kp _FIND_PREV      &kp _FIND_NEXT,          &none  &tog LAYER_Number   &none,      &kp EQUAL      &kp DOT     &kp N0,             &kp LS(N9)    &kp LBKT    &kp RBKT     &kp LS(N0)     &kp LS(N2)
)

GLV80_LAYER(Function,
      &none             &kp RET           &kp SPACE             &kp TAB            &kp BSPC  &kp K_CALC,                                                                                  &kp K_CALC         &kp F7      &kp F8      &kp F9   &kp F10         &kp F13,
  &sk LSHFT  &kp LEFT_PINKY_MOD  &kp LEFT_RINGY_MOD  &kp LEFT_MIDDY_MOD  &kp LEFT_INDEX_MOD   &kp K_WWW,                                                                                   &kp K_WWW         &kp F4      &kp F5      &kp F6   &kp F11         &kp F14,
      &none         &select_all        &select_line        &select_word           &kp _FIND  &kp _FILES,  &tog LAYER_Function  &none  &none,  &kp C_BRI_MIN  &kp C_BRI_DN  &kp C_BRI_UP,  &kp _FILES         &kp F1      &kp F2      &kp F3   &kp F12         &kp F15,
      &none           &kp _UNDO           &kp _REDO      &kp _FIND_PREV     &kp _FIND_NEXT,                             &none  &none  &none,     &kp C_MUTE  &kp C_VOL_DN  &kp C_VOL_UP,              &kp C_BRI_MAX  &kp C_PREV  &kp C_NEXT  &kp C_PP  &kp C_BRI_AUTO
)

GLV80_LAYER(Symbol,
     &kp GRAVE      &kp COMMA    &kp LS(N9)            &kp LS(N0)       &kp SEMI       &kp DOT,                                                                                         &none                &none                &none                &none                &none   &none,
    &kp LS(N1)       &kp LBKT  &kp LS(LBKT)          &kp LS(RBKT)       &kp RBKT  &kp LS(FSLH),                                                                                     &kp GRAVE              &kp DEL          &kp LS(TAB)              &kp INS              &kp ESC   &none,
    &kp LS(N3)     &kp LS(N6)     &kp EQUAL         &kp LS(MINUS)     &kp LS(N4)    &kp LS(N8),                                                                          &kp LS(SINGLE_QUOTE)             &kp BSPC              &kp TAB            &kp SPACE              &kp RET   &none,
 &kp LS(GRAVE)  &kp LS(COMMA)  &kp LS(BSLH)             &kp MINUS    &kp LS(DOT)      &kp FSLH,   &kp BSLH       &kp DOT  &kp LS(N8),  &none   &none              &none,              &kp SQT  &sk RIGHT_INDEX_MOD  &sk RIGHT_MIDDY_MOD  &sk RIGHT_RINGY_MOD  &sk RIGHT_PINKY_MOD   &none,
      &dot_dot     &kp LS(N7)       &kp SQT  &kp LS(SINGLE_QUOTE)  &kp LS(EQUAL),               &kp LS(N5)  &kp LS(SEMI)  &kp LS(N2),  &none   &none  &tog LAYER_Symbol,                                     &none                &none                &none                &none   &none
)

GLV80_LAYER(Mouse,
  &none             &mkp MB5            &mkp RCLK            &mkp MCLK             &mkp LCLK     &mkp MB4,                                                                                &mkp MB4            &mkp LCLK            &mkp RCLK            &mkp MCLK             &mkp MB5        &none,  
  &none   &kp LEFT_PINKY_MOD   &kp LEFT_RINGY_MOD   &kp LEFT_MIDDY_MOD    &kp LEFT_INDEX_MOD  &msc MSC_UP,                                                                             &msc MSC_DN       &mmv MOVE_LEFT       &mmv MOVE_DOWN         &mmv MOVE_UP      &mmv MOVE_RIGHT   &msc MSC_R,  
  &none          &msc MSC_DN             &kp _CUT            &kp _COPY            &kp _PASTE  &msc MSC_DN,  &kp _PASTE  &kp _COPY  &kp _CUT  &kp _CUT,         &kp _COPY  &kp _PASTE,  &msc MSC_UP  &sk RIGHT_INDEX_MOD  &sk RIGHT_MIDDY_MOD  &sk RIGHT_RINGY_MOD  &sk RIGHT_PINKY_MOD   &msc MSC_L, 
  &none  &mo LAYER_MouseWarp  &mo LAYER_MouseFine  &mo LAYER_MouseSlow  &mo LAYER_MouseFast,                 &mkp LCLK  &mkp RCLK  &mkp MB4     &none,  &tog LAYER_Mouse       &none,               &mo LAYER_MouseFast  &mo LAYER_MouseFine  &mo LAYER_MouseSlow  &mo LAYER_MouseWarp    &kp K_APP  
)

GLV80_LAYER_TRANS(MouseFine)
GLV80_LAYER_TRANS(MouseSlow)
GLV80_LAYER_TRANS(MouseFast)
GLV80_LAYER_TRANS(MouseWarp)

GLV80_LAYER(Factory,
        &kp F1    &kp F2   &kp F3    &kp F4      &kp F5,                                                                                &kp F6  &kp F7     &kp F8    &kp F9    &kp F10,
     &kp EQUAL    &kp N1   &kp N2    &kp N3      &kp N4  &kp N5,                                                                &kp N6  &kp N7  &kp N8     &kp N9    &kp N0    &kp MINUS,
       &kp TAB     &kp Q    &kp W     &kp E       &kp R  &kp T,                                                                 &kp Y   &kp U   &kp I      &kp O     &kp P     &kp BSLH,
       &kp ESC     &kp A    &kp S     &kp D       &kp F  &kp G,                                                                 &kp H   &kp J   &kp K      &kp L     &kp SEMI  &kp SQT,
     &kp GRAVE     &kp Z    &kp X     &kp C       &kp V  &kp B, &kp LSHFT  &kp LCTRL  &lower,  &kp LGUI  &kp RCTRL  &kp RSHFT,  &kp N   &kp M   &kp COMMA  &kp DOT   &kp FSLH  &kp PG_UP,
  &magic MAG 0  &kp HOME  &kp END  &kp LEFT  &kp RIGHT,         &kp BSPC   &kp DEL  &kp LALT,  &kp RALT  &kp RET    &kp SPACE,          &kp UP  &kp DOWN   &kp LBKT  &kp RBKT  &kp PG_DN
)

GLV80_LAYER(Lower,
     &none  &none  &none  &none      &none  &none,                                                           &kp KP_CLEAR   &kp KP_N7     &kp KP_N8   &kp KP_N9  &kp KP_MINUS         &kp FSLH,
     &none  &none  &none  &none      &none  &none,                                                            &kp KP_LPAR   &kp KP_N4     &kp KP_N5   &kp KP_N6   &kp KP_PLUS  &kp KP_MULTIPLY,
  &kp RALT  &none  &none  &none      &none  &none,                                                            &kp KP_RPAR   &kp KP_N1     &kp KP_N2   &kp KP_N3  &kp KP_ENTER     &kp KP_EQUAL,  
     &none  &none  &none  &none      &none  &none,    &tog FUNC     &none  &none,  &none     &none  &tog TYPING,       &none   &kp KP_N0  &kp KP_COMMA  &kp KP_DOT  &kp KP_ENTER            &none,  
     &none  &none  &none  &none   &to BASE,         &tog CURSOR  &tog NUM  &none,  &none  &tog MSE  &tog SYM,                   &none         &none       &none         &none            &none  
)

GLV80_LAYER(Magic,
   &bt BT_CLR            &none            &none            &none            &none,                                                                                             &none   &none   &none   &none  &bt BT_CLR_ALL,
        &to 0            &to 1            &to 2            &to 3            &to 4            &to 5,                                                                    &none   &none   &none   &none   &none           &none,
        &none  &rgb_ug RGB_SPI  &rgb_ug RGB_SAI  &rgb_ug RGB_HUI  &rgb_ug RGB_BRI  &rgb_ug RGB_TOG,                                                                    &none   &none   &none   &none   &none           &none,
  &bootloader  &rgb_ug RGB_SPD  &rgb_ug RGB_SAD  &rgb_ug RGB_HUD  &rgb_ug RGB_BRD  &rgb_ug RGB_EFF,                                                                    &none   &none   &none   &none   &none     &bootloader,
   &sys_reset            &none            &none            &none            &none            &none,  &bt_2   &bt_3     &tog FACT,  &kp _POWER  &kp _SLEEP  &kp _LOCK,  &none   &none   &none   &none   &none      &sys_reset,
        &none            &none            &none            &none            &none,                   &bt_0   &bt_1  &out OUT_USB,       &none       &none      &none,          &none   &none   &none   &none           &none
)